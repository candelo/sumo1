## sdkconfig.defaults
```kconfig
CONFIG_FREERTOS_HZ=1000
CONFIG_ESP_MAIN_TASK_STACK_SIZE=4096
CONFIG_FREERTOS_UNICORE=n
CONFIG_ESP_SYSTEM_EVENT_TASK_STACK_SIZE=4096
# Disable Bluetooth and WiFi to save RAM
CONFIG_BT_ENABLED=n
CONFIG_ESP_WIFI_ENABLED=n
# ADC calibration
CONFIG_ADC_CAL_EFUSE_TP_ENABLE=y
CONFIG_ADC_CAL_EFUSE_VREF_ENABLE=y
CONFIG_ADC_CAL_LUT_ENABLE=y
```
